## c3-battery-switch/main/Kconfig.projbuild
```kconfig
menu "Конфигурация Батарейного Выключателя ESP32-C3"

    menu "Управление клавишами и линиями"

        config C3_LINE1_ENABLE
            bool "Включить клавишу Линии 1 (GPIO 2)"
            default y
            help
                Включает опрос и пробуждение контроллера по нажатию клавиши Линии 1 (GPIO 2).
                При нажатии на хаб передается команда переключения для Конечной Точки 1 (EP 1).
                Если выключатель используется как одноклавишный, отключение этой опции
                устраняет привязку пина и уменьшает размер кода.

        config C3_LINE2_ENABLE
            bool "Включить клавишу Линии 2 (GPIO 3)"
            default y
            help
                Включает опрос и пробуждение контроллера по нажатию клавиши Линии 2 (GPIO 3).
                При нажатии на хаб передается команда переключения для Конечной Точки 2 (EP 2).
                Если выключатель используется как одноклавишный, отключение этой опции
                устраняет привязку пина и уменьшает размер кода.

    endmenu

    menu "Настройки логирования и оптимизация веса"

        config C3_LOG_ENABLE
            bool "Включить информационное логирование (ESP_LOGI)"
            default y
            help
                Включает вывод информационных сообщений в порт UART.
                При отключении все информационные логи вырезаются из кода компилятором,
                что удаляет все текстовые строки из секции .rodata, значительно снижая вес
                прошивки и ускоряя пробуждение процессора из Deep Sleep.

    endmenu

endmenu
```

## c3-battery-switch/sdkconfig.defaults
```kconfig
CONFIG_IDF_TARGET="esp32c3"
CONFIG_ESP_DEFAULT_CPU_FREQ_MHZ_80=y
CONFIG_PM_ENABLE=y
CONFIG_ESP_CONSOLE_USB_SERIAL_JTAG=y
CONFIG_ESP_CONSOLE_SECONDARY_NONE=y

# Русскоязычные настройки выключателя ESP32-C3
CONFIG_C3_LINE1_ENABLE=y
CONFIG_C3_LINE2_ENABLE=y
# CONFIG_C3_LOG_ENABLE is not set
```

## c6-coordinator-hub/main/Kconfig.projbuild
```kconfig
menu "Конфигурация Zigbee Хаба и Эндпоинтов (ESP32-C6)"

    menu "Управление конечными точками Zigbee (Endpoints)"

        config ZB_ENDPOINT_1_ENABLE
            bool "Включить Конечную Точку 1 (Линия 1 / EP 1)"
            default y
            help
                Включает создание и регистрацию конечной точки EP 1 (кластер On/Off 0x0006).
                Используется для управления первым каналом реле Tuya TS0002.
                При отключении весь код регистрации EP 1 и обработчики команд исключаются
                из компиляции, экономя память Flash и RAM.

        config ZB_ENDPOINT_2_ENABLE
            bool "Включить Конечную Точку 2 (Линия 2 / EP 2)"
            default y
            help
                Включает создание и регистрацию конечной точки EP 2 (кластер On/Off 0x0006).
                Используется для управления вторым каналом реле Tuya TS0002.
                При отключении код регистрации EP 2 и привязки кластеров исключаются
                из компиляции, уменьшая размер прошивки.

        config ZB_TUYA_UNCOUPLING_ENABLE
            bool "Включить алгоритм расцепления линий Tuya (Uncoupling Sequence)"
            default y
            help
                Включает 5-шаговую процедуру отправки служебных команд APS/ZCL для
                расцепления спаренных каналов Tuya (запись атрибута 0xFFDE=0x0D,
                разблокировка 0xF0, ZDO привязка).
                Если используются стандартные не-Tuya реле или расцепление не требуется,
                отключение этой опции полностью удаляет функции расцепления, таблицы
                атрибутов и строки сообщений из бинарного файла.

    endmenu

    menu "Аппаратные модули и мост ESP-NOW"

        config ESPNOW_BRIDGE_ENABLE
            bool "Включить беспроводной мост ESP-NOW (приёмник C3 -> C6)"
            default y
            help
                Включает приём команд с беспроводных пультов ESP32-C3 по протоколу ESP-NOW
                (режим Wi-Fi SoftAP, канал 1, без энергосбережения модема).
                При отключении опции сетевой стек Wi-Fi AP, очередь FreeRTOS и задача
                обработки пакетов espnow_bridge_task полностью исключаются из компиляции,
                что даёт максимальное сокращение веса прошивки и освобождает память.

        config RGB_LED_ENABLE
            bool "Включить адресный RGB-светодиод (WS2812 на GPIO 8)"
            default y
            help
                Включает цветовую индикацию состояния сети (янтарный поиск, зеленое сопряжение,
                синяя/зеленая вспышка при переключении каналов).
                При отключении драйвер RMT led_strip, цветовые таблицы и фоновые задачи
                заменяются пустыми inline-заглушками, исключая тяжёлый код драйвера RMT из Flash.

        config SWITCH_DRIVER_ENABLE
            bool "Включить опрос локальных физических кнопок (GPIO 6, 7, 9)"
            default y
            help
                Включает опрос физических клавиш, подключенных непосредственно к плате ESP32-C6
                (кнопка BOOT на GPIO 9, внешние клавиши на GPIO 6 и GPIO 7).
                Если плата используется исключительно как хаб-приёмник без проводных кнопок,
                отключение этой опции удаляет задачу опроса кнопок и таймеры дебаунса.

    endmenu

    menu "Настройки логирования и отладки (Оптимизация размера)"

        config ZB_LOG_ENABLE
            bool "Включить информационное логирование Zigbee координатора (ESP_LOGI)"
            default y
            help
                Включает вывод сообщений ESP_LOGI для событий Zigbee сети.
                При отключении все информационные логи заменяются пустыми макросами,
                что удаляет сотни форматированных строк из секции .rodata и кардинально
                уменьшает вес итогового бинарного файла .bin.

        config ZB_LOG_CLUSTER_DISCOVERY
            bool "Логировать детальный опрос кластеров (Simple Descriptors)"
            depends on ZB_LOG_ENABLE
            default y
            help
                Выводит подробный список входных/выходных кластеров (On/Off, Basic, Scenes,
                Tuya Private Cluster) при обнаружении реле.
                Отключение убирает текстовые описания кластеров и детальный дамп дескрипторов.

        config ZB_LOG_TUYA_STEPS
            bool "Логировать пошаговое выполнение расцепления Tuya"
            depends on ZB_LOG_ENABLE && ZB_TUYA_UNCOUPLING_ENABLE
            default y
            help
                Выводит статус выполнения каждого из 5 шагов процедуры расцепления каналов.
                Отключение экономит Flash память.

        config ESPNOW_LOG_PACKETS
            bool "Логировать входящие пакеты ESP-NOW моста"
            depends on ZB_LOG_ENABLE && ESPNOW_BRIDGE_ENABLE
            default y
            help
                Выводит данные принятых пакетов (длину, номер линии, действие, телеметрию).
                При отключении логирование пакетов выключается, обработка происходит
                бесшумно и максимально быстро.

    endmenu

endmenu
```

## c6-coordinator-hub/sdkconfig.defaults
```kconfig
CONFIG_IDF_TARGET="esp32c6"

# Custom Partition Table
CONFIG_PARTITION_TABLE_CUSTOM=y
CONFIG_PARTITION_TABLE_CUSTOM_FILENAME="partitions.csv"
CONFIG_PARTITION_TABLE_FILENAME="partitions.csv"
CONFIG_PARTITION_TABLE_OFFSET=0x8000

# Zigbee Configuration: Coordinator (ZC)
CONFIG_ZB_ENABLED=y
CONFIG_ZB_ZCZR=y
# CONFIG_ZB_ZED is not set

# Sleep disabled for Coordinator stability
# CONFIG_PM_ENABLE is not set
# CONFIG_FREERTOS_USE_TICKLESS_IDLE is not set
# CONFIG_IEEE802154_SLEEP_ENABLE is not set

CONFIG_BOOTLOADER_SKIP_VALIDATE_IN_DEEP_SLEEP=y
CONFIG_RTC_CLK_SRC_INT_RC=y

# Эндпоинты Zigbee
CONFIG_ZB_ENDPOINT_1_ENABLE=y
CONFIG_ZB_ENDPOINT_2_ENABLE=y
CONFIG_ZB_TUYA_UNCOUPLING_ENABLE=y

# Аппаратные модули
CONFIG_ESPNOW_BRIDGE_ENABLE=y
CONFIG_RGB_LED_ENABLE=y
CONFIG_SWITCH_DRIVER_ENABLE=y

# Логирование
# CONFIG_ZB_LOG_ENABLE is not set
```
